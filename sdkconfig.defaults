## sdkconfig.defaults
```kconfig
# 芯片目标
CONFIG_IDF_TARGET="esp32s3"

# 蓝牙：启用 NimBLE（BLE only）
CONFIG_BT_ENABLED=y
CONFIG_BT_NIMBLE_ENABLED=y

# 分区表：单工厂固件（大分区，无 OTA）
CONFIG_PARTITION_TABLE_SINGLE_APP_LARGE=y

# 板载 Flash 硬件参数（2MB / DIO / 80MHz）
CONFIG_ESPTOOLPY_FLASHSIZE_2MB=y
CONFIG_ESPTOOLPY_FLASHMODE_DIO=y
CONFIG_ESPTOOLPY_FLASHFREQ_80M=y
```
